## embedded/firmware/components/audio_feedback/Kconfig
```kconfig
menu "Musopti Audio"
    config MUSOPTI_AUDIO_SIMULATED
        bool "Use simulated audio (log only, no I2S)"
        default n
        help
            When enabled, tone playback is simulated via log messages.
            Disable this when building for the real board with ES8311.
endmenu
```

## embedded/firmware/components/display/Kconfig
```kconfig
menu "Musopti Display"
    config MUSOPTI_DISPLAY_SIMULATED
        bool "Use simulated display (log only, no LVGL)"
        default y
        help
            When enabled, the display module logs state updates instead of
            driving the SH8601 AMOLED panel.  Disable when building for
            the real board with the 368x448 screen.
endmenu
```

## embedded/firmware/components/imu/Kconfig
```kconfig
menu "Musopti IMU"

    config MUSOPTI_IMU_SIMULATED
        bool "Use simulated IMU data instead of hardware"
        default y
        help
            When enabled, the IMU module generates synthetic motion data
            instead of reading the QMI8658 sensor over I2C.
            Useful for testing motion detection logic without the board.

endmenu
```

## embedded/firmware/sdkconfig.defaults
```kconfig
CONFIG_IDF_TARGET="esp32c6"

# Musopti: hardware-first defaults for the real board
# CONFIG_MUSOPTI_IMU_SIMULATED is not set
# CONFIG_MUSOPTI_AUDIO_SIMULATED is not set
# CONFIG_MUSOPTI_DISPLAY_SIMULATED is not set

# BLE (NimBLE)
CONFIG_BT_ENABLED=y
CONFIG_BT_NIMBLE_ENABLED=y
CONFIG_BT_NIMBLE_MAX_CONNECTIONS=1

# FreeRTOS
CONFIG_FREERTOS_HZ=1000

# Log level
CONFIG_LOG_DEFAULT_LEVEL_INFO=y
```
